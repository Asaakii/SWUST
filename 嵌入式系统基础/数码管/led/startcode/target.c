/****************************************Copyright (c)**************************************************
;**                                
;**                                 西南科技大学计算机学院
;**                                   
;**                                 http://cs.swust.edu.cn
;**            
;**             日期：   2004.11.8
;**             描述：  lpc2200.h文件，硬件相关资源配置文件，支持LPC2200系列芯片和Lpc2100系列
;**                     芯片，对于每个C或C++程序工程必须包含该文件来完成对ARM资源的分配，所有
;**                     VPB外设地址由该文件分配，分配的地址应保持与实际硬件资源相同。错误的分
;**                     配将导致程序的运行不正常。
;**
;**------------------------------------------------------------------------------------------------------
;********************************************************************************************************/
/********************************************************************************************************/

#define IN_TARGET
#include "config.h"

#include "led.h"
/*********************************************************************************************************
** 函数名称: IRQ_Exception
** 功能描述: 中断异常处理程序，用户根据需要自己改变程序
**非向量中断

**------------------------------------------------------------------------------------------------------
********************************************************************************************************/
        void __irq IRQ_Exception(void)
{
    while(1);                   // 这一句替换为自己的代码
}

/*********************************************************************************************************
** 函数名称: FIQ_Exception
** 功能描述: 快速中断异常处理程序，用户根据需要自己改变程序
**           
**------------------------------------------------------------------------------------------------------
********************************************************************************************************/
        void FIQ_Exception(void)
{
    while(1);                   // 这一句替换为自己的代码
}

/*********************************************************************************************************
** 函数名称: TargetInit
** 功能描述: 目标板初始化代码，在需要的地方调用，根据需要改变
**------------------------------------------------------------------------------------------------------
********************************************************************************************************/
       void TargetInit(void)
{
       //URAT1_Init(9600);  
     //   URAT0_Init(9600); 
    //  LedKeyInit();
     // Timer0_Init(0xfffff,0x01); 
     // Timer1_Init(0x2fff,0x01);
     // DataLedInit();
    //   FontLedInit();
    //   MotorInit();
    //   LCDInit();
    //   I2CInit();
    /* 添加自己的代码 */   
   
    
}

/*********************************************************************************************************
** 函数名称: TargetResetInit
** 功能描述: 调用main函数前目标板初始化代码，根据需要改变，不能删除
**-------------------------------------------------------------------------------------------------------
********************************************************************************************************/
        void TargetResetInit(void)
{
#ifdef __DEBUG    
    MEMMAP = 0x3;                   //remap
#endif

#ifdef __OUT_CHIP    
    MEMMAP = 0x3;                   //remap
#endif

#ifdef __IN_CHIP    
    MEMMAP = 0x1;                   //remap
#endif

/* 设置系统各部分时钟 */
    PLLCON = 1;
#if (Fpclk / (Fcclk / 4)) == 1
    VPBDIV = 0;
#endif
#if (Fpclk / (Fcclk / 4)) == 2
    VPBDIV = 2;
#endif
#if (Fpclk / (Fcclk / 4)) == 4
    VPBDIV = 1;
#endif

#if (Fcco / Fcclk) == 2
    PLLCFG = ((Fcclk / Fosc) - 1) | (0 << 5);
#endif
#if (Fcco / Fcclk) == 4
    PLLCFG = ((Fcclk / Fosc) - 1) | (1 << 5);
#endif
#if (Fcco / Fcclk) == 8
    PLLCFG = ((Fcclk / Fosc) - 1) | (2 << 5);
#endif
#if (Fcco / Fcclk) == 16
    PLLCFG = ((Fcclk / Fosc) - 1) | (3 << 5);
#endif
    PLLFEED = 0xaa;
    PLLFEED = 0x55;
    while((PLLSTAT & (1 << 10)) == 0);
    PLLCON = 3;
    PLLFEED = 0xaa;
    PLLFEED = 0x55;
    
    /* 设置存储器加速模块 */
    MAMCR = 0;
#if Fcclk < 20000000
    MAMTIM = 1;
#else
#if Fcclk < 40000000
    MAMTIM = 2;
#else
    MAMTIM = 3;
#endif
#endif
    MAMCR = 2;
    
    /* 初始化VIC */
    VICIntEnClr = 0xffffffff;
    VICVectAddr = 0;
    VICIntSelect = 0;

    /* 添加自己的代码 */

}

/*********************************************************************************************************
**                            End Of File
********************************************************************************************************/
