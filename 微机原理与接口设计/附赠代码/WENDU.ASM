;=========================================================
; 文件名: WENDU.ASM
; 功能描述: 温度闭环控制实验，通过专用图形显示界面观察
;           实验现象
;           IOY0--8255, IOY3--8254, IOY1--AD0809
;=========================================================

SSTACK	SEGMENT STACK
		DW 256 DUP(?)
TOP		LABEL WORD
SSTACK	ENDS
DATA	SEGMENT
TS		DB 64H						;采样周期
SPEC	DW 0032H					;给定温度值32H为50℃
IBAND	DW 0060H					;PID算法中积分分离值
KPP		DW 1F60H					;PID算法中比例项系数值
KII		DW 0010H					;PID算法中积分项系数值
KDD		DW 0020H					;PID算法中微分项系数值
CH1		DB ?						;专用图形显示的CH1通道
CH2		DB ?						;专用图形显示的CH2通道
CH3		DB ?						;专用图形显示的CH3通道
YK		DW ?						;电机转速反馈量
CK		DB ?						;电机转速控制量
TC		DB ?
TKMARK	DB ?
ADMARK	DB ?
ADVALUE	DB ?
FPWM	DB ?
CK_1	DB ?
EK_1	DW ?
AEK_1	DW ?
BEK		DW ?
AAAA	DB ?
VAA		DB ?
BBB		DB ?
VBB		DB ?
R0		DW ?
R1		DW ?
R2		DW ?
R3		DW ?
R4		DW ?
R5		DW ?
R6		DW ?
R7		DB ?
R8		DW ?
;热敏电阻温度表
TAB		DB 14H,14H,14H,14H,14H,14H,14H,14H,14H,14H,15H,16H,17H,18H,19H,1AH
		DB 1BH,1CH,1DH,1EH,1EH,1FH,20H,21H,23H,24H,25H,26H,27H,28H,29H,2AH
		DB 2BH,2CH,2DH,2EH,2FH,31H,32H,32H,33H,34H,35H,36H,37H,38H,39H,3AH
		DB 3BH,3CH,3DH,3EH,3FH,40H,42H,43H,44H,45H,46H,47H,48H,49H,4AH,4BH
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		DB 0FFH,0FFH,0FFH,0FFH,0FFH
DATA	ENDS

CODE	SEGMENT
		ASSUME  CS:CODE,DS:DATA
START:	MOV AX, DATA
		MOV DS, AX
MAIN:	CALL INIT					;系统初始化
		STI
M1:		CMP	TKMARK, 01H    		;判采样周期到否
		JNZ	M1
		MOV	TKMARK, 00H
M2:		CMP	ADMARK, 01H
		JNZ	M2
		MOV	ADMARK, 00H
		MOV AX, 0000H				;查温度表
		MOV	AL, ADVALUE
		MOV	BX, OFFSET TAB
		ADD	BX, AX
		MOV	AL, [BX]	
		MOV YK, AX
		CALL PID					;调用PID计算控制量 CK
		MOV AL, CK				;根据 CK 产生 PWM 脉冲
		SUB AL, 80H         
		JC  IS0
		MOV AAAA, AL
		JMP COU
IS0:	MOV AL, 00H
		MOV AAAA, AL        
COU:	MOV AL, 7FH
		SUB AL, AAAA
		MOV BBB, AL
		MOV AX, SPEC				;将给定量SPEC 存入 CH1
		MOV CH1, AL
		MOV AX, YK           		;将反馈量YK 存入 CH2
		MOV CH2, AL
		MOV AL, CK           		;将控制量CK 存入 CH3
		MOV CH3, AL
		CALL PUT_COM				;调用PUT_COM显示给定、反馈与控制量的波形
		JMP M1         
PUT_COM:							;显示子程序
		MOV DX, 03FBH
		IN  AL, DX
		AND AL, 7FH
		OUT	DX, AL
		MOV DX, 03FDH
WAIT1:	IN	AL, DX
		TEST AL, 20H
		JZ	WAIT1
		MOV DX, 03F8H
		MOV AL, CH1	
		OUT DX, AL
		MOV DX, 03FDH
WAIT2:	IN  AL, DX
		TEST AL, 20H
		JZ WAIT2
		MOV DX, 03F8H        
		MOV	AL, CH2
		OUT	DX, AL
		MOV DX, 03FDH
WAIT3:	IN  AL, DX
		TEST AL, 20H
		JZ WAIT3
		MOV DX, 03F8H        
		MOV	AL, CH3
		OUT	DX, AL
		RET

INIT:	NOP							;写中断入口地址
		PUSH DS
		XOR AX, AX
		MOV DS, AX
		MOV AX, OFFSET IRQ6   		;8259 IRQ10定时中断
		MOV SI, 0038H            
		MOV [SI], AX
		MOV AX, CS
		MOV SI, 003AH
		MOV [SI], AX
		MOV AX, OFFSET IRQ7    		;8259 IRQ7中断
		MOV SI, 003CH
		MOV [SI], AX
		MOV AX, CS
		MOV SI, 003EH
		MOV [SI], AX
		CLI
		POP DS
        		
		IN  AL, 21H
		AND AL, 3FH				;允许 IRQ6,IRQ7
		OUT 21H, AL
        
		MOV CK, 00H				;变量初始化
		MOV YK, 0000H
		MOV CK_1, 00H
		MOV EK_1, 0000H
		MOV AEK_1, 0000H
		MOV BEK, 0000H
		MOV BBB, 00H
		MOV VBB, 00H
		MOV R0, 0000H
		MOV R1, 0000H
		MOV R2, 0000H
		MOV R3, 0000H
		MOV R4, 0000H
		MOV R5, 0000H
		MOV R6, 0000H
		MOV R7, 00H
		MOV	R8, 0000H
		MOV TKMARK, 00H
		MOV FPWM, 01H
		MOV	ADMARK, 00H
		MOV	ADVALUE, 00H
		MOV AAAA, 7FH
		MOV VAA, 7FH
		MOV TC, 00H
        
		MOV DX, 606H
		MOV AL, 80H				;初始化 8255-B口
		OUT DX, AL
		MOV DX, 640H			;启动 ADC0809
		OUT DX, AL
		MOV DX, 6C6H
		MOV AL, 36H				;8254 计数器0输出 OUT0
		OUT DX, AL
		MOV DX, 6C0H            
		MOV AL, 10H				;定时 10ms 方波
		OUT DX, AL
		MOV AL, 27H
		OUT DX, AL
		RET
IRQ7:	NOP
		PUSH AX
		PUSH DX
		MOV DX, 0640H
		IN	AL, DX				;读 ADC0809 采样值
		MOV ADVALUE, AL
		MOV ADMARK, 01H  
		MOV AL, 20H        		;关闭 IRQ7
		OUT 20H, AL
		POP DX
		POP AX
		IRET
IRQ6:	NOP 
		PUSH AX
		PUSH DX
		MOV  DX, 0640H
		OUT  DX, AL				;启动 ADC0809
		MOV	 AL, TC
		CMP	 AL, TS
		JNC	 TT2
		INC  TC
TT1:	CALL KJ
		MOV  AL, 20H			;关闭 IRQ6
		OUT  20H, AL
		POP  DX
		POP  AX
		IRET
TT2:	MOV	TKMARK, 01H
		MOV	TC, 00H
		JMP	TT1
KJ:		NOP  					;PWM子程序
		PUSH AX
		CMP FPWM, 01H
		JNZ TEST2
		CMP VAA, 00H
		JNZ ANOT0
		MOV FPWM, 02H
		MOV AL, BBB
		CLC
		RCR AL, 01H
		MOV VBB, AL
		JMP TEST2
ANOT0:	DEC VAA
		MOV DX, 0602H				;加温
		MOV AL, 01H
		OUT DX, AL
TEST2:	CMP FPWM, 02H
		JNZ OUTT
		CMP VBB, 00H
		JNZ BNOT0
		MOV FPWM, 01H
		MOV AL, AAAA
		CLC
		RCR AL, 01H
		MOV VAA, AL
		JMP OUTT
BNOT0:	DEC VBB
		MOV DX, 0602H				;停止加温
		MOV AL, 00H
		OUT DX, AL  
OUTT:	POP AX
		RET       
;==============================================
;PID算法子程序
;根据SPEC, KPP, KII, KDD及YK计算对应控制量CK
;==============================================    
PID:	MOV AX, SPEC				;求偏差EK
		SUB AX, YK
		MOV R0, AX
		MOV R1, AX				;求偏差变化量AEK
		SUB AX, EK_1
		MOV R2, AX				;求BEK
		SUB AX, AEK_1
		MOV	BEK, AX
		MOV R8, AX
		MOV AX, R1
		MOV EK_1, AX
		MOV AX, R2
		MOV AEK_1, AX
		TEST R1, 8000H
		JZ 	EK1
		NEG R1  
EK1:	MOV AX, R1				;判积分分离值
		SUB AX, IBAND
		JC 	II 
		MOV R3, 00H
		JMP DDD
II:		MOV AL, TS				;计算积分项
		MOV AH, 00H
		MOV CX, R1
		MUL CX
		MOV CX, KII
		DIV CX
		MOV R3, AX
		TEST R0, 8000H
		JZ 	DDD
		NEG R3
DDD:	TEST BEK, 8000H			;计算微分项
		JZ 	DDD1
		NEG BEK
DDD1:	MOV AX, BEK
		MOV CX, KDD
		MUL	CX
		PUSH AX
		PUSH DX
		MOV AL, TS						
		MOV AH, 00H
		MOV CX, 0008H
		MUL CX
		MOV CX, AX
		POP DX
		POP AX
		DIV CX
		MOV R4, AX
		TEST R8, 8000H
		JZ 	DD1
		NEG R4
DD1:	MOV AX, R3				;积分项和微分项相加，判溢出
		ADD AX, R4
		MOV R5, AX
		JO 	L9
L2:		MOV AX, R5
		ADD AX, R2
		MOV R6, AX
		JO 	L3 
L5:		MOV AX, R6				;计算比例项
		MOV CX, KPP
		IMUL CX
		MOV CX, 1000H
		IDIV CX
		MOV	CX, AX
		RCL	AH, 01H
		PUSHF
		RCR	AL, 01H
		POPF
		JC	LLL1				;判溢出，溢出赋极值
		CMP	CH, 00H
		JZ	LLL2
		MOV	AL, 7FH
		JMP	LLL2
LLL1:	CMP	CH, 0FFH
		JZ	LLL2
		MOV	AL, 80H				;CK=CK_1+CK
LLL2:	MOV	R7, AL      
		ADD AL, CK_1
		JO 	L8
L18:	MOV CK_1, AL
		ADD AL, 80H
		MOV CK, AL
		RET						;PID 子程序返回
L8:		TEST R7, 80H			;溢出处理程序
		JNZ L17
		MOV AL, 7FH
		JMP L18
L17:	MOV AL, 80H
		JMP L18               	
L9:		TEST R3, 8000H
		JNZ L1
		MOV	R5, 7FFFH
		JMP L2
L1:		MOV R5, 8000H
		JMP L2
L3:		TEST R2, 8000H
		JNZ L4
		MOV R6, 7FFFH
		JMP L5
L4:		MOV R6, 8000H
		JMP L5
CODE	ENDS
		END START
